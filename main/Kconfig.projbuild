## main/Kconfig.projbuild
```kconfig
menu "Resilient IoT Edge"

    config RIE_EMERGENCY_MIN_BUFFER_HOURS
        int "Guaranteed minimum buffer duration in EMERGENCY (hours)"
        default 8
        range 1 168
        help
            The firmware calculates the required write interval to
            guarantee this minimum duration before the local buffer (LittleFS)
            starts dropping data, based on the partition size.

endmenu
```

## sdkconfig.defaults
```kconfig
# =============================================================================
# DEV1 — Custom Partition Table
# =============================================================================
CONFIG_PARTITION_TABLE_CUSTOM=y
CONFIG_PARTITION_TABLE_CUSTOM_FILENAME="partitions.csv"
CONFIG_ESPTOOLPY_FLASHSIZE_8MB=y

# =============================================================================
# RTOS Optimization (Dual-Core & FSM Determinism)
# =============================================================================
CONFIG_FREERTOS_HZ=1000
# Main task stack: 8KB for LittleFS + OLED I2C concurrency (DEV1+)
CONFIG_ESP_MAIN_TASK_STACK_SIZE=8192

# =============================================================================
# System Resilience (Hardware Watchdog)
# =============================================================================
CONFIG_ESP_TASK_WDT_INIT=y
CONFIG_ESP_TASK_WDT_TIMEOUT_S=30

# =============================================================================
# Build & Debug Configuration
# =============================================================================
CONFIG_COMPILER_OPTIMIZATION_DEBUG=y

# =============================================================================
# Component Configuration
# =============================================================================
# Suppress legacy I2C deprecation warning — migration tracked in DEV roadmap
CONFIG_I2C_SUPPRESS_DEPRECATE_WARN=y
```
