#include <string.h>
#include "freertos/FreeRTOS.h"
#include "freertos/task.h"
#include "driver/gpio.h"
#include "driver/i2c.h"
#include "oled_driver.h"

// --- HELTEC V3 OFFICIAL PINOUT ---
#define OLED_SDA 17
#define OLED_SCL 18
#define OLED_RST 21
#define OLED_VEXT 36

#define I2C_PORT I2C_NUM_0
#define OLED_ADDR 0x3C

// --- 5x7 MINI FONT ---
static const uint8_t font5x7[59][5] = {
    {0x00, 0x00, 0x00, 0x00, 0x00}, {0x00, 0x00, 0x2f, 0x00, 0x00}, {0x00, 0x07, 0x00, 0x07, 0x00}, {0x14, 0x7f, 0x14, 0x7f, 0x14},
    {0x24, 0x2a, 0x7f, 0x2a, 0x12}, {0x23, 0x13, 0x08, 0x64, 0x62}, {0x36, 0x49, 0x55, 0x22, 0x50}, {0x00, 0x05, 0x03, 0x00, 0x00},
    {0x00, 0x1c, 0x22, 0x41, 0x00}, {0x00, 0x41, 0x22, 0x1c, 0x00}, {0x14, 0x08, 0x3E, 0x08, 0x14}, {0x08, 0x08, 0x3E, 0x08, 0x08},
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    {0x63, 0x14, 0x08, 0x14, 0x63}, {0x07, 0x08, 0x70, 0x08, 0x07}, {0x61, 0x51, 0x49, 0x45, 0x43}
};

// --- HELTEC POWER MANAGEMENT ---
void oled_power_setup(void) {
    gpio_reset_pin(OLED_VEXT);
    gpio_set_direction(OLED_VEXT, GPIO_MODE_OUTPUT);
    gpio_set_level(OLED_VEXT, 0); 
    vTaskDelay(pdMS_TO_TICKS(100)); 

    gpio_reset_pin(OLED_RST);
    gpio_set_direction(OLED_RST, GPIO_MODE_OUTPUT);
    gpio_set_level(OLED_RST, 0);
    vTaskDelay(pdMS_TO_TICKS(50));
    gpio_set_level(OLED_RST, 1);
    vTaskDelay(pdMS_TO_TICKS(100)); 
}

// --- I2C COMMUNICATION ---
void i2c_master_init(void) {
    i2c_config_t conf = {
        .mode = I2C_MODE_MASTER,
        .sda_io_num = OLED_SDA, .scl_io_num = OLED_SCL,
        .sda_pullup_en = GPIO_PULLUP_ENABLE, .scl_pullup_en = GPIO_PULLUP_ENABLE,
        .master.clk_speed = 400000,
    };
    i2c_param_config(I2C_PORT, &conf);
    i2c_driver_install(I2C_PORT, conf.mode, 0, 0, 0);
}

// Funções static (privadas) - O main.c não precisa enxergar isso
static void oled_send_cmd(uint8_t cmd) {
    i2c_cmd_handle_t cmd_handle = i2c_cmd_link_create();
    i2c_master_start(cmd_handle);
    i2c_master_write_byte(cmd_handle, (OLED_ADDR << 1) | I2C_MASTER_WRITE, true);
    i2c_master_write_byte(cmd_handle, 0x00, true);
    i2c_master_write_byte(cmd_handle, cmd, true);
    i2c_master_stop(cmd_handle);
    i2c_master_cmd_begin(I2C_PORT, cmd_handle, 1000 / portTICK_PERIOD_MS);
    i2c_cmd_link_delete(cmd_handle);
}

static void oled_send_data(const uint8_t *data, size_t len) {
    i2c_cmd_handle_t cmd_handle = i2c_cmd_link_create();
    i2c_master_start(cmd_handle);
    i2c_master_write_byte(cmd_handle, (OLED_ADDR << 1) | I2C_MASTER_WRITE, true);
    i2c_master_write_byte(cmd_handle, 0x40, true);
    i2c_master_write(cmd_handle, data, len, true);
    i2c_master_stop(cmd_handle);
    i2c_master_cmd_begin(I2C_PORT, cmd_handle, 1000 / portTICK_PERIOD_MS);
    i2c_cmd_link_delete(cmd_handle);
}

static void oled_draw_char(uint8_t x, uint8_t page, char c) {
    if (c < 32 || c > 90) c = 32;
    uint8_t idx = c - 32;
    oled_send_cmd(0xB0 + page);
    oled_send_cmd(0x00 + (x & 0x0F));
    oled_send_cmd(0x10 + ((x >> 4) & 0x0F));
    oled_send_data((const uint8_t*)font5x7[idx], 5);
    uint8_t space = 0x00;
    oled_send_data(&space, 1);
}

// Funções públicas expostas
void oled_software_setup(void) {
    uint8_t init_cmds[] = {
        0xAE, 0x20, 0x00, 0xB0, 0xC8, 0x00, 0x10, 0x40, 0x81, 0xFF,
        0xA1, 0xA6, 0xA8, 0x3F, 0xA4, 0xD3, 0x00, 0xD5, 0x80, 0xD9,
        0xF1, 0xDA, 0x12, 0xDB, 0x40, 0x8D, 0x14, 0xAF
    };
    for(size_t i = 0; i < sizeof(init_cmds); i++) oled_send_cmd(init_cmds[i]);
}

void oled_clear(void) {
    uint8_t zero[128];
    memset(zero, 0, 128);
    for (int i = 0; i < 8; i++) {
        oled_send_cmd(0xB0 + i); oled_send_cmd(0x00); oled_send_cmd(0x10);
        oled_send_data(zero, 128);
    }
}

void oled_print(uint8_t x, uint8_t page, const char *str) {
    while (*str) {
        oled_draw_char(x, page, *str);
        x += 6;
        str++;
    }
}